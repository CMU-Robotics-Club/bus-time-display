// Define the pins used for each connection
#define CLK 21
#define SO 15
int ROWS[] = {19,18,5,17,16,4,2};

// Define the font
#define LETTER_WIDTH 7
uint8_t FONT[][LETTER_WIDTH] {
{0x00,0x00,0x00,0x00,0x00,0x00}, //  
{0x08,0x08,0x08,0x08,0x00,0x08}, // !
{0x14,0x14,0x00,0x00,0x00,0x00}, // "
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{0x10,0x08,0x0C,0x08,0x08,0x10}  // }
};

// 96-bit buffer to store the data before it is written to the display
uint32_t message_bits[] = {0,0,0};

// Calculate the index into the font array given the character
uint8_t font_index(char c) {
  return c-32;
}

// Pack a row of bits to display
void pack_message_bits(int row, int col_offset) {
  message_bits[0] = 0;
  message_bits[1] = 0;
  message_bits[2] = 0;
  
  int mbits_i = 0;
  int bits_left = 95 + col_offset;
  for(int i = 0; bits_left > 0; i++) {
    int shift_amt = bits_left - (32 * (2-mbits_i)) - 7;
    if(shift_amt > 31) {
      bits_left -= 7;
      continue;
    }
    if(shift_amt >= 0) {
      if(i < message.length()) {
        message_bits[mbits_i] |= ((uint32_t) FONT[font_index(message.charAt(i))][row]) << shift_amt;
      } else {
        message_bits[mbits_i] |= ((uint32_t) FONT[font_index(' ')][row]) << shift_amt;
      }
    } else {
      if(i < message.length()) {
        message_bits[mbits_i] |= ((uint32_t) FONT[font_index(message.charAt(i))][row]) >> -shift_amt;
      } else {
        message_bits[mbits_i] |= ((uint32_t) FONT[font_index(' ')][row]) >> -shift_amt;
      }
      mbits_i++;
      if(mbits_i <= 2) {
        shift_amt = bits_left - (32 * (2-mbits_i)) - 7;
        if(i < message.length()) {
          message_bits[mbits_i] |= ((uint32_t) FONT[font_index(message.charAt(i))][row]) << shift_amt;
        } else {
          message_bits[mbits_i] |= ((uint32_t) FONT[font_index(' ')][row]) << shift_amt;
        }
      }
    }
    bits_left -= 7;
  }
}

void setup_display() {
  pinMode(CLK, OUTPUT);
  digitalWrite(CLK, LOW);
  pinMode(SO, OUTPUT);
  digitalWrite(SO, LOW);
  for(int i = 0; i < 7; i++) {
    pinMode(ROWS[i], OUTPUT);
    digitalWrite(ROWS[i], LOW);
  }
}

void draw_display(int col_offset) {
  // Display each row in succession
  for (int row = 0; row < 7; row++) {
    pack_message_bits(row, col_offset);

    // Shift the bits out to the display
    for(int i = 0; i < 3; i++) {
      for(int j = 31; j >= 0; j--) {
        digitalWrite(SO, ((message_bits[i]) >> j) & 1);
        delayMicroseconds(1);
        digitalWrite(CLK, HIGH);
        delayMicroseconds(1);
        digitalWrite(CLK, LOW);
        delayMicroseconds(1);
      }
    }

    // Enable the row for some amount of time
    digitalWrite(ROWS[row], HIGH);
    delayMicroseconds(200);
    digitalWrite(ROWS[row], LOW);
  }
}
